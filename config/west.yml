## config/west.yml
```yaml
manifest:
  remotes:
  - name: zmkfirmware
    url-base: https://github.com/zmkfirmware
  - name: nxtkb
    url-base: https://github.com/nxtkb
  - name: urob
    url-base: https://github.com/urob
projects:
  - name: zmk
    remote: zmkfirmware
    revision: v0.3
    import: app/west.yml
  - name: zmk-behavior-report
    remote: nxtkb
    revision: main
    import: west.yml
  - name: zmk-adaptive-key
    remote: urob
    revision: v0.3 # Should match ZMK release.
  self:
    path: config
```
